#include <LiquidCrystal.h>
#include <unistd.h>

#include <SPI.h>
#include <String.h>
#include <stdio.h>
#include <stdlib.h>

char incomingChar = 0;   // for incoming serial data
String string_Ary[10];
char numChar[10];
double features[10];
int cnt = 0;
int num_cnt = 0;
int thinking = 0;
//global Declarations for 2D Arrays variabls
int layer1_row_ar1 = 40;
int layer1_col_ar1 = 10;
int layer1_row_ar2 = 10;
int layer1_col_ar2 = 1;

int layer2_row_ar1 = 2;
int layer2_col_ar1 = 40;
int layer2_row_ar2 = 40;
int layer2_col_ar2 = 1;


double  w1[40][10] = {
		{1.74281466498143,0.799431600577583,1.21243291718074,0.820060966210418,-0.464739242935653,-1.60550512043602,-1.97754091337418,-3.46615235146503,-0.322586724698488,-2.33317788297732},
		{0.886419152794136,-2.50060039338225,0.704943700740531,0.952652035971719,-0.116071715947840,0.483872969076379,-1.26843956957144,-0.166948460297526,0.417817208672114,-1.42920101523800},
		{0.940995875989958,-0.806976019486037,-0.112934754081502,-0.528810485121697,0.660816202478541,0.584399908245544,-2.23144504715724,-1.92251387362591,-1.80149272408836,0.0939828803292681},
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		{-0.339071986522494,0.873523442394498,2.77286476228999,-0.639645508212700,-0.452238103548602,-0.430012585019941,-0.711745114083527,-0.170972906400341,0.944019650247499,-0.636462273124270}};
double  w2[2][40] = {
			{-2.30218592852364,0.596065434634614,-1.69531184265836,-2.41735102275185,-0.977173963361709,-0.288659347980310,-0.130399098238212,0.251410546806799,0.459843991085512,-0.950352675723268,-3.29692388180403,0.831019915827949,2.99595529443744,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-0.284803967205501,-1.29593296633951},
			{-0.453816254560524,1.59601685916235,0.552743750379699,-0.905174437944342,-1.17686089186109,-0.407599454946065,1.43759011497738,1.07909168064664,-0.898104744016308,0.545295311742265,-0.239908996885434,0.542462982607120,3.30243541701008,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-1.36333774120700,-1.03226220721609}};


double networkout_val[2][1];
double product1[40][1];
double product2[40][1];  

#define PIN_GATE_IN 7
#define IRQ_GATE_IN  6
#define PIN_LED_OUT 13


 
//instantiate the lcd
LiquidCrystal lcd(10, 9, 5, 4, 3, 2);

void setup(){
  //AUDIO SET UP
 
 lcd.begin(20,4);
  Serial.begin(9600);
  //  Configure LED pin as output
  pinMode(PIN_LED_OUT, OUTPUT);
  
  // configure input to interrupt
  pinMode(PIN_GATE_IN, INPUT);

  lcd.clear();  
  }

void loop()
{
  if(thinking == 0){
  	printGUI();
  }
  else{
  	printThinkGUI();
  }
  

  // send data only when you receive data:
        if (Serial.available() > 0) {
        	thinking = 1;
                // read the incoming byte:
                incomingChar = Serial.read();
                

                if(incomingChar == '#')
                {
                	lcd.setCursor(0,2);
                	string_Ary[cnt].concat(numChar);
                	lcd.print(string_Ary[cnt]);
                	cnt++;
                	memset(numChar, 0, 10);
                	num_cnt = 0;
                
                }
                else{
                	numChar[num_cnt] += incomingChar;
                    num_cnt++;
                }
            
                lcd.clear();
        }
        if(cnt == 10){

        	for (int i = 0; i < 10; i++)
        	{
        		features[i] = string_Ary[i].toFloat();
        		// string_Ary[i] = "";
        	}

    	    
        	
        	for(int i = 0 ; i < 10; i++)
        	{
        		lcd.setCursor(0,0);
    	    	lcd.print("FEATURES:");
        		lcd.setCursor(0,1);
        		lcd.print(features[i]);
        		
        		delay(500);
        		lcd.clear();
        	}
        	nueralNet(features);
        	numdecide();
        	lcd.clear();


        	memset(string_Ary,0,10);
        	memset(numChar, 0, 10);
            num_cnt = 0;
        	cnt = 0;
        	thinking = 0;
        }
 
}

void printGUI(){

  lcd.setCursor(0, 0);
  lcd.print("Nueral Voice Detect");
  delay(25);

}

void printThinkGUI(){

  
  lcd.setCursor(0,0);
  lcd.print("Feature Extract... ");
  delay(25);

}
void numdecide(){
	lcd.setCursor(0,3);
	int networkout[2];

	
    if(networkout_val[0][0] < .5)
    	networkout[0] = 0;
    else
    	networkout[0] = 1;

    if(networkout_val[1][0] < .5)
    	networkout[1] = 0;
    else
    	networkout[1] = 1;
   
    if(networkout[0] == 0 && networkout[1] == 0){
    	lcd.print("I heard ONE.");
    	delay(5000);
    }
    else if(networkout[0] == 0 && networkout[1] == 1){
    	lcd.print("I heard TWO. ");
    	delay(5000);
    }
    else if(networkout[0] == 1 && networkout[1] == 0){
    	lcd.print("I heard THREE. ");
    	delay(5000);
    }
    else if(networkout[0] == 1 && networkout[1] == 1){
    	lcd.print("I heard FOUR. ");
    	delay(5000);
    }
    else{
    	lcd.print("Sorry I could not understand. ");
    	delay(2000);
    }
    

}

void nueralNet(double * features){
	lcd.setCursor(0,0);
    lcd.print("Running network : ");

    
	
	double ** layer_tmp;
	double layer1out_val[40][1];
	
	
	double t1[40][1];
	double t2[2][1];

	
	/***************Layer 1 OUTPUT *****************/
	/*This module is for handeling the layer 1 output
	 *and setting the nuerons in the first layer
	 */
	
	matrixMultiply_t1(w1,features);
	
	for(int i = 0; i < 40; i++){
		for(int j = 0; j < 1; j++){
			t1[i][j] = product1[i][j];
		}
	}

   

	layer_tmp = layer1out(40,1,t1);

	
			
	for(int i = 0; i < 40; i++)
		for(int j = 0; j < 1; j++)
			layer1out_val[i][j] = layer_tmp[i][j];
		
	destroyArray(layer_tmp);	
	
	
	/***************NETWORK OUTPUT *****************/
	matrixMultiply_t2(w2,layer1out_val);
	for(int i = 0; i < 2; i++)
		for(int j = 0; j < 1; j++)
			t2[i][j] = product2[i][j];
		
	
	
	layer_tmp = networkout(2,1,t2);
	
	for(int i = 0; i < 2; i++)
		for(int j = 0; j < 1; j++)
			networkout_val[i][j] = layer_tmp[i][j];
	
	
    
	destroyArray(layer_tmp);
	
}
//converts dynamic array to static 
double sigmoid(double x)
{
     double exp_value;
     double return_value;

     /*** Exponential calculation ***/
     exp_value = exp((double) -x);

     /*** Final sigmoid value ***/
     return_value = 1 / (1 + exp_value);

     return return_value;
}
void destroyArray(double** arr){
    free(*arr);
    free(arr);
}
double** createArray(int m, int n){
    
	double **arr = (double **)malloc(m * sizeof(double *));
	for (int i=0; i<m; i++)
		arr[i] = (double *)malloc(n * sizeof(double));

	return arr;
}



double ** layer1out(int m, int n,double t1[40][1]  )
{


	double ** layer1_output = createArray(m,n);
    
	for (int i = 0; i < m; i++)
	{
		for (int j = 0; j < n; j++)
		{
			layer1_output[i][j] = sigmoid(t1[i][j]);
		
		}
	}
	
	
	return layer1_output;
}

double ** networkout(int m, int n , double t2[][1] )
{
	
	double ** layer2_output = createArray(m,n);
	
	
		for (int i = 0; i < m; i++)
		{
			for (int j = 0; j < n; j++)
			{
				layer2_output[i][j] = sigmoid(t2[i][j]);	
			}
		}
	return layer2_output;
}

void matrixMultiply_t1(double  first[][10] , double second[10]){
  int  c, d, k;
  double  sum = 0;
  double multiply[40][40];
 
	for (c = 0; c < layer1_row_ar1; c++){ 
		for (d = 0; d < layer1_col_ar2; d++){ 
			for (k = 0; k < layer1_row_ar2; k++){ 
				sum = sum + first[c][k]*second[k];
			}
		multiply[c][d] = sum;
		sum = 0;
		}
	}


  for (c = 0; c < layer1_row_ar1; c++) 
    for (d = 0; d < layer1_col_ar2; d++)
      product1[c][d] = multiply[c][d];
   
 
  
 

}
void matrixMultiply_t2(double  first[][40] , double second[][1]){
	int  c, d, k;
	double  sum = 0;
	double multiply[40][40];

	
	
	for (c = 0; c < layer2_row_ar1; c++) {
		for (d = 0; d < layer2_col_ar2; d++) {
			for (k = 0; k < layer2_row_ar2; k++) {
				sum = sum + first[c][k]*second[k][d];
			}
			
			multiply[c][d] = sum;
			sum = 0;
		}
	}
	for (c = 0; c < layer1_row_ar1; c++) {
		for (d = 0; d < layer2_col_ar2; d++)
			
			product2[c][d] = multiply[c][d];
		
	}
	

	
}













